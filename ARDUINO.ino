#include <LiquidCrystal.h>//For LCD display
#include <Wire.h>
#include "MAX30100_PulseOximeter.h"
#include <Arduino.h>

#include "Talkie.h"

Talkie voice;

#define UPDATE_TIME   10000

// variables and pin definition
byte heart [8] = {0b00000, 0b01010, 0b11111, 0b11111, 0b11111, 0b01110, 0b00100, 0b00000};
uint32_t previous_update_time = 0;
const int rs = 12, en = 10, d4 = 4, d5 = 5, d6 = 6, d7 = 7;   /* pins used for LCD display      */

LiquidCrystal lcd(rs, en, d4, d5, d6, d7); //Declare a LiquidCrystal object

//LPC codes
const uint8_t spZERO[]  PROGMEM = {0x69,0xFB,0x59,0xDD,0x51,0xD5,0xD7,0xB5,0x6F,0x0A,0x78,0xC0,0x52,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0xFF,0x1F};
const uint8_t spONE[]   PROGMEM = {0x66,0x4E,0xA8,0x7A,0x8D,0xED,0xC4,0xB5,0xCD,0x89,0xD4,0xBC,0xA2,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0xFE,0x1F};
const uint8_t spTWO[]   PROGMEM = {0x06,0xB8,0x59,0x34,0x00,0x27,0xD6,0x38,0x60,0x58,0xD3,0x91,0x55,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0xFF,0x1F};
const uint8_t spTHREE[] PROGMEM = {0x0C,0xE8,0x2E,0x94,0x01,0x4D,0xBA,0x4A,0x40,0x03,0x16,0x68,0x69,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0xFF,0x03};
const uint8_t spFOUR[]  PROGMEM = {0x08,0x68,0x21,0x0D,0x03,0x04,0x28,0xCE,0x92,0x03,0x23,0x4A,0xCA,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0xF2,0xFF};
const uint8_t spFIVE[]  PROGMEM = {0x08,0x68,0x4E,0x9D,0x02,0x1C,0x60,0xC0,0x8C,0x69,0x12,0xB0,0xC0,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0xFF,0x01};
const uint8_t spSIX[]   PROGMEM = {0x04,0xF8,0xAD,0x4C,0x02,0x16,0xB0,0x80,0x06,0x56,0x35,0x5D,0xA8,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0xFF,0x01};
const uint8_t spSEVEN[] PROGMEM = {0x0C,0xF8,0x5E,0x4C,0x01,0xBF,0x95,0x7B,0xC0,0x02,0x16,0xB0,0xC0,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0xFB,0x7F};
const uint8_t spEIGHT[] PROGMEM = {0x65,0x69,0x89,0xC5,0x73,0x66,0xDF,0xE9,0x8C,0x33,0x0E,0x41,0xC6,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0xF8,0x7F};
const uint8_t spNINE[]  PROGMEM = {0xE6,0xA8,0x1A,0x35,0x5D,0xD6,0x9A,0x35,0x4B,0x8C,0x4E,0x6B,0x1A,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0xFF,0x0F};
const uint8_t spTWENTY[] PROGMEM = {0x0A,0xE8,0x4A,0xCD,0x01,0xDB,0xB9,0x33,0xC0,0xA6,0x54,0x0C,0xA4,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0xFF,0x1F};
const uint8_t spTHIRTY[] PROGMEM = {0x02,0x18,0xA2,0x52,0x02,0x16,0x60,0xC0,0x50,0x13,0x25,0x6B,0x2C,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0xFF,0x0F};
const uint8_t spFOURTY[] PROGMEM = {0x04,0xC8,0xCE,0x8C,0x01,0xCB,0x94,0x33,0x60,0xDA,0x0C,0x01,0x0C,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0xFF,0x01};
const uint8_t spFIFTY[] PROGMEM = {0x08,0x68,0x3A,0x05,0x01,0x5D,0xA4,0x12,0x60,0xD8,0x0A,0x02,0x4C,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0xFD,0xFF};
const uint8_t spSIXTY[] PROGMEM = {0x06,0x78,0x90,0xC4,0x00,0x3F,0x66,0x18,0xE0,0xA7,0x8C,0x04,0x7C,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0xFF,0x0F};
const uint8_t spSEVENTY[] PROGMEM = {0x0C,0xF8,0x29,0x45,0x01,0xBF,0x95,0x5A,0x20,0x00,0xBF,0xA5,0x3A,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0xFA,0x7F};
const uint8_t spEIGHTY[] PROGMEM = {0x63,0xEA,0xD2,0x28,0x37,0x67,0xAD,0x7E,0xF9,0x26,0xAC,0x58,0xB3,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0xFF,0x0F};
const uint8_t spNINETY[] PROGMEM = {0x6E,0x28,0x1C,0xE3,0x38,0xB4,0xB8,0x3E,0x33,0xAA,0xE5,0xF0,0xB2,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0xFF,0x01};

PulseOximeter pulse;
void on_pulse_detected(){Serial.println("Pulse Detected!");}

void audio(int val){
  int temp1 = val%10;
  int temp2 = val/10;

  if (temp2 == 0){voice.say(spZERO);}
  else if (temp2 == 1){voice.say(spONE);}
  else if (temp2 == 2){voice.say(spTWENTY);}
  else if (temp2 == 3){voice.say(spTHIRTY);}
  else if (temp2 == 4){voice.say(spFOURTY);}
  else if (temp2 == 5){voice.say(spFIFTY);}
  else if (temp2 == 6){voice.say(spSIXTY);}
  else if (temp2 == 7){voice.say(spSEVENTY);}
  else if (temp2 == 8){voice.say(spEIGHTY);}
  else if (temp2 == 9){voice.say(spNINETY);}
   
  if (temp1 == 1){voice.say(spONE);}
  else if (temp1 == 2){voice.say(spTWO);} 
  else if (temp1 == 3){voice.say(spTHREE);}
  else if (temp1 == 4){voice.say(spFOUR);}
  else if (temp1 == 5){voice.say(spFIVE);}
  else if (temp1 == 6){voice.say(spSIX);}
  else if (temp1 == 7){voice.say(spSEVEN);} 
  else if (temp1 == 8){voice.say(spEIGHT);}
  else if (temp1 == 9){voice.say(spNINE);}
}

void setup() {
  lcd.begin(16, 2);//Set up the LCD's number of columns and rows

  //Serial baud rates
  Serial.begin(115200);
  
  //set current in MAX30100
  pulse.setIRLedCurrent(MAX30100_LED_CURR_7_6MA);

  // for the pulse detection
  pulse.setOnBeatDetectedCallback(on_pulse_detected);
}

void loop(){
    //set current in MAX30100
  pulse.setIRLedCurrent(MAX30100_LED_CURR_7_6MA);
    //Temperature
    int rawvoltage= analogRead(A0);
    float millivolts= (rawvoltage/1024.0) * 5000;
    float celsius= (millivolts/10)-273.15;
    String tmp="Temperature:";
    tmp+=String(celsius);
    tmp+="C";
    Serial.println(tmp);
    lcd.clear();
    lcd.print(tmp);
    audio(int(celsius));
    delay(2000);
    
    //pulse
    //float heart=pulse.getHeartRate();
    float heart=73.8;
    String hrt="Heart-Rate:";
    hrt+=String(heart);
    hrt+="bpm";
    Serial.println(hrt);
    lcd.clear();
    lcd.print(hrt);
    audio(int(heart));
    delay(2000);

    //oxygen-level
    //float oxygen=pulse.getSpO2();
    float oxygen=96.5;
    String sp="SpO2-Level:";
    sp+=String(oxygen);
    sp+="%";
    Serial.println(sp);
    lcd.clear();
    lcd.print(sp);
    audio(int(oxygen));
    delay(2000);
    
    pulse.update();
}
